## boards/arm/z_iaq/Kconfig.board
```kconfig
# Z IAQ board configuration

# Copyright (c) 2023 CATIE
# SPDX-License-Identifier: Apache-2.0

config BOARD_Z_IAQ
	bool "Z IAQ Development Board"
	depends on SOC_NRF52832_QFAA
```

## boards/arm/zest_core_nrf52832/Kconfig.defconfig
```kconfig
# Z IAQ board configuration

# Copyright (c) 2023 CATIE
# SPDX-License-Identifier: Apache-2.0

if BOARD_Z_IAQ

config BOARD
	default "z_iaq"

config BT_CTLR
	default BT

endif # BOARD_Z_IAQ
```

## boards/arm/zest_core_nrf52832/z_iaq_defconfig
```kconfig
# SPDX-License-Identifier: Apache-2.0

CONFIG_SOC_SERIES_NRF52X=y
CONFIG_SOC_NRF52832_QFAA=y
CONFIG_BOARD_Z_IAQ=y

# enable uart driver
CONFIG_SERIAL=y

# enable GPIO
CONFIG_GPIO=y

# console
CONFIG_CONSOLE=y
CONFIG_UART_CONSOLE=y

# enable MPU
CONFIG_ARM_MPU=y

# Enable pin RST
CONFIG_GPIO_AS_PINRESET=y

# Enable clock control
CONFIG_CLOCK_CONTROL_NRF_K32SRC_RC=y
CONFIG_CLOCK_CONTROL_NRF_K32SRC_20PPM=y

CONFIG_PINCTRL=y
```

## boards/catie/z_iaq/Kconfig.z_iaq
```kconfig
# Copyright (c) 2023 CATIE
# SPDX-License-Identifier: Apache-2.0

config BOARD_Z_IAQ
	select SOC_NRF52832_QFAA
```

## boards/catie/z_iaq/z_iaq_defconfig
```kconfig
# SPDX-License-Identifier: Apache-2.0

# enable uart driver
CONFIG_SERIAL=y

# enable GPIO
CONFIG_GPIO=y

# console
CONFIG_CONSOLE=y
CONFIG_UART_CONSOLE=y

# enable MPU
CONFIG_ARM_MPU=y

# Enable clock control
CONFIG_CLOCK_CONTROL_NRF_K32SRC_RC=y
CONFIG_CLOCK_CONTROL_NRF_K32SRC_20PPM=y

CONFIG_PINCTRL=y
```
